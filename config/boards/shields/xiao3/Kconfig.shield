## config/boards/shields/xiao3/Kconfig.shield
```kconfig
config SHIELD_XIAO3_LEFT
    def_bool $(shields_list_contains,xiao3_left)

config SHIELD_XIAO3_RIGHT
    def_bool $(shields_list_contains,xiao3_right)
```
